## script.its
```
/*
 * Automatic software update for U-Boot
 */

/dts-v1/;

/ {
	description = "Upgrade Image";
	#address-cells = <1>;

	images {
		script@1 {
			data = /incbin/("out.scr");
			type = "script";
			load = "0x00408000";
			entry = "0x00408058";
			compression = "none";
			hash@1 {
				algo = "sha1";
			};
			signature@1 {
				algo = "sha1,rsa2048";
				key-name-hint = "dev";
			};
		};
	};
	configurations {
		default = "conf@1";
		conf@1 {
			script = "script@1";
		};
	};
};
```

## sign.its
```
/*
 * Automatic software update for U-Boot
 */

/dts-v1/;

/ {
	description = "Upgrade Image";
	#address-cells = <1>;

	images {
		script@1 {
			data = "";
			hash@1 {
				algo = "sha1";
			};
			signature@1 {
				algo = "sha1,rsa2048";
				key-name-hint = "dev";
			};
		};
	};
	configurations {
		default = "conf@1";
		conf@1 {
			script = "script@1";
		};
	};
};
```
